#include <Seeed_Arduino_SSCMA.h>
#include <ESP32Servo.h>
#include <HCSR04.h>
#include <Wire.h>
#include <Adafruit_GFX.h>
#include <Adafruit_SSD1306.h>

#define SCREEN_WIDTH 128 // OLED display width, in pixels
#define SCREEN_HEIGHT 64 // OLED display height, in pixels

// Declaration for an SSD1306 display connected to I2C (SDA, SCL pins)
Adafruit_SSD1306 display(SCREEN_WIDTH, SCREEN_HEIGHT, &Wire, -1);

UltraSonicDistanceSensor distanceSensor(14, 12);

static const int servoPin = 18;

Servo servo1;

SSCMA AI;

int pred_index = 0;

//gambar 
const unsigned char Anorganik [] PROGMEM = {
	0x00, 0x00, 0x00, 0x00, 0x00, 0x00, 0x00, 0x00, 0x00, 0x00, 0x00, 0x00, 0x00, 0x00, 0x00, 0x00, 
	0x00, 0x00, 0x00, 0x00, 0x00, 0x00, 0x00, 0x00, 0x00, 0x00, 0x00, 0x00, 0x00, 0x00, 0x00, 0x00, 
	0x00, 0x00, 0x00, 0x00, 0x00, 0x00, 0x00, 0x00, 0x00, 0x00, 0x00, 0x00, 0x00, 0x00, 0x00, 0x00, 
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	0x00, 0x00, 0x00, 0x00, 0x00, 0x00, 0x00, 0x00, 0x00, 0x00, 0x00, 0x00, 0x00, 0x00, 0x00, 0x00
};

const unsigned char Organik [] PROGMEM = {
	0x00, 0x00, 0x00, 0x00, 0x00, 0x00, 0x00, 0x00, 0x00, 0x00, 0x00, 0x00, 0x00, 0x00, 0x00, 0x00, 
	0x00, 0x00, 0x00, 0x00, 0x00, 0x00, 0x00, 0x00, 0x00, 0x00, 0x00, 0x00, 0x00, 0x00, 0x00, 0x00, 
	0x00, 0x00, 0x00, 0x00, 0x00, 0x00, 0x00, 0x00, 0x00, 0x00, 0x00, 0x00, 0x00, 0x00, 0x00, 0x00, 
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	0x00, 0x00, 0x00, 0x00, 0x00, 0x00, 0x00, 0x00, 0x00, 0x00, 0x00, 0x00, 0x00, 0x00, 0x00, 0x00
};


void setup()
{
    AI.begin();
    Serial.begin(9600);
    servo1.attach(servoPin);
    servo1.write(88); //set awal 0 degreess

    if(!display.begin(SSD1306_SWITCHCAPVCC, 0x3C)) { // Address 0x3D for 128x64
    Serial.println(F("SSD1306 allocation failed"));
    for(;;);
  }
  
    display.setTextSize(1);
    display.setTextColor(WHITE);

    display.setCursor(0, 0);
    display.println("Hello");
    display.display();
    delay(1000);


    while (!Serial);
    Serial.println("Inferencing - Grove AI V2 / XIAO ESP32S3");

}

void loop()
{

    float value = distanceSensor.measureDistanceCm();
    int logic = 0;

    if (!AI.invoke())
    {
        Serial.println("invoke success");
        Serial.print("perf: prepocess=");
        Serial.print(AI.perf().prepocess);
        Serial.print(", inference=");
        Serial.print(AI.perf().inference);
        Serial.print(", postpocess=");
        Serial.println(AI.perf().postprocess);

        pred_index = AI.classes()[0].target;

        if(value > 10 && value <= 22) {
            logic +=1;
            if( pred_index == 0 && logic == 1) {
                display.clearDisplay();
                display.setCursor(0, 0);
                display.drawBitmap(0, 0,  Anorganik, 128, 64, WHITE);
                display.display(); 

                servo1.write(0);
                
                delay(2000);
            } else if(pred_index == 1 && logic == 1) {
                display.clearDisplay();
                display.setCursor(0, 0);
                display.drawBitmap(0, 0,  Organik, 128, 64, WHITE);
                display.display(); 
                
                servo1.write(180);
                delay(2000);
            }
        } else {
            logic = 0;
            if(pred_index == 0 && logic == 0){
                display.clearDisplay();
                display.display(); 
                servo1.write(88);
               
            } else if (pred_index == 1 && logic == 0) {
                display.clearDisplay();
                display.display(); 
                servo1.write(88); 
                
            }

        }

        Serial.print("Result= Label: ");
        Serial.print(pred_index);
        Serial.print(", score=");
        Serial.println(AI.classes()[0].score);
    }

    

}